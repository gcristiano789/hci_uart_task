## build_nrf52832_mdk/Kconfig.modules
```kconfig
osource "C:/Users/Admin/ncs/v1.3.1/nrf/Kconfig.nrf"

osource "C:/Users/Admin/ncs/v1.3.1/bootloader/mcuboot/zephyr/Kconfig"

osource "C:/Users/Admin/ncs/v1.3.1/nrfxlib/Kconfig.nrfxlib"
```
